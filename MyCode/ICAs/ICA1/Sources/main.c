/////////////////////////////////////////////////////////////////////////////
// 9S12X Program: YourProg - MiniExplanation
// Processor:     MC9S12XDP512
// Bus Speed:     20 MHz (Requires Active PLL)
// Author:        Simon Walker
// Details:       A more detailed explanation of the program is entered here
// Date:          Date Created
// Revision History :
//  each revision will have a date + desc. of changes

/////////////////////////////////////////////////////////////////////////////
#include <hidef.h>      /* common defines and macros */
#include "derivative.h" /* derivative-specific definitions */

// other system includes or your includes go here
//#include "pll.h"
//#include <stdlib.h>
//#include <stdio.h>

/////////////////////////////////////////////////////////////////////////////
// Local Prototypes
/////////////////////////////////////////////////////////////////////////////
        static void RED(int bOn);
        static void GREEN(int bOn);
/////////////////////////////////////////////////////////////////////////////
// Global Variables
/////////////////////////////////////////////////////////////////////////////
         unsigned int uiMainLoopCount = 0;
         
/////////////////////////////////////////////////////////////////////////////
// Constants
/////////////////////////////////////////////////////////////////////////////

/////////////////////////////////////////////////////////////////////////////
// Main Entry
/////////////////////////////////////////////////////////////////////////////
void main(void)
{
  // main entry point - these two lines must appear first
  _DISABLE_COP();
  //EnableInterrupts;
  
  /////////////////////////////////////////////////////////////////////////////
  // one-time initializations
  /////////////////////////////////////////////////////////////////////////////
            PT1AD1 &= 0x1F;    //Turns off LEDs
            DDR1AD1 = 0xE0;    //Makes LEDs outputs, switches inputs           
            ATD1DIEN1 |= 0x1F; //digital inputs on for switches (?)
  /////////////////////////////////////////////////////////////////////////////
  // main program loop
  /////////////////////////////////////////////////////////////////////////////
  for (;;)
  {


            
                ++uiMainLoopCount;
                RED(uiMainLoopCount < 0x1000);






                GREEN(uiMainLoopCount >= 0x1000);
            
  }                   
}

/////////////////////////////////////////////////////////////////////////////
// Functions
/////////////////////////////////////////////////////////////////////////////
         static void RED (int bOn)
        {
            if (bOn != 0)
                PT1AD1 |= (char)(((unsigned long)1 << (7)));
            else
                PT1AD1 &= 0x7F;
        }

        static void GREEN(int bOn)
        {
            char garbage = bOn;
            if (garbage) 
              PT1AD1|=0x20;
            
            else
            PT1AD1&=0xDF;            
        }
/////////////////////////////////////////////////////////////////////////////
// Interrupt Service Routines
/////////////////////////////////////////////////////////////////////////////
